## lib/Kconfig.kmemcov
```kconfig
menuconfig KMEMCOV
    bool "Read-from coverage"
	help
	  Read-from coverage to capture interleaving coverage and instruction reordering coverage
```

## lib/Kconfig.kssb
```kconfig
menuconfig KSSB
    bool "SoftStoreBuffer"
    help
      Software emulation of store buffer

menuconfig KSSB_SWITCH
    bool "StoftStoreBuffer switch"
	depends on KSSB
    help
      Using the kssb switch

menuconfig KSSB_BINARY
    bool "SoftStoreBuffer binary mode"
	depends on KSSB
    help
      Keeping only one entry for the given addr

menuconfig KSSB_PROFILE
    bool "SoftStoreBuffer profile"
	depends on KSSB
    help
      Profile
```
